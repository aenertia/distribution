/*
 * RK3568 Optimized Overclock
 *
 * CPU: Add turbo boost OPP at conservative voltage.
 *   2088 MHz @ 1050mV — validated on RGDS, 60°C peak (15s stress)
 *
 * GPU: Add 900 MHz OPP.
 *   Mali-G52 EE validated at 900 MHz on RK3562 (same IP, mainline DTS).
 *   RK3568 GPU max is 800 MHz stock; 900 MHz tested stable.
 *
 * Stack with an undervolt DTBO for reduced thermals.
 * Enable boost: echo 1 > /sys/devices/system/cpu/cpufreq/boost
 */
/dts-v1/;
/plugin/;

/ {
fragment@0 {
	target-path = "/opp-table-0";
	__overlay__ {
		opp-2088000000 {
			opp-hz = /bits/ 64 <2088000000>;
			opp-microvolt = <1050000 1050000 1150000>;
			turbo-mode;
		};
	};
};
fragment@1 {
	target-path = "/opp-table-1";
	__overlay__ {
		opp-900000000 {
			opp-hz = /bits/ 64 <900000000>;
			opp-microvolt = <1000000 1000000 1350000>;
		};
	};
};
};
